## sdkconfig.defaults
```kconfig
# 核心：指定目标芯片为ESP32-S3
CONFIG_IDF_TARGET_ESP32S3=y
CONFIG_ESP32S3_DEFAULT_CPU_FREQ_240=y

# Flash 配置（必须！）
CONFIG_ESPTOOLPY_FLASHMODE=dio
CONFIG_ESPTOOLPY_FLASHFREQ=40m
CONFIG_ESPTOOLPY_FLASHSIZE=4MB

# 分区表配置
CONFIG_PARTITION_TABLE_CUSTOM=y
CONFIG_PARTITION_TABLE_CUSTOM_FILENAME="partitions.csv"

# 串口配置：UART0，波特率115200
CONFIG_ESP_CONSOLE_UART_NUM=0
CONFIG_ESP_CONSOLE_UART_BAUDRATE=115200

# 禁用无用功能，减小固件
CONFIG_BT_ENABLED=n
CONFIG_WIFI_ENABLED=n
CONFIG_MBEDTLS_ENABLED=n

# 启用日志
CONFIG_LOG_DEFAULT_LEVEL=INFO
CONFIG_CONSOLE_UART_DEFAULT=y

# 暂时禁用SPRAM，先确保基本功能正常
# CONFIG_SPIRAM_SUPPORT=n

# 对于E101-S3MN8-PS（2MB PSRAM），使用以下配置
CONFIG_SPIRAM_SUPPORT=y
CONFIG_SPIRAM=y
CONFIG_SPIRAM_BOOT_INIT=y
CONFIG_SPIRAM_MODE_QUAD=y
CONFIG_SPIRAM_SPEED_40M=y
CONFIG_SPIRAM_USE_CAPS_ALLOC=y
CONFIG_SPIRAM_ALLOW_BSS_SEG_EXTERNAL_MEMORY=y
```
